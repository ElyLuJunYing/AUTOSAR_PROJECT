AUTOSAR XML (schema 4-2-1)
package /Dio
  module config Dio: implementation-config-variant=VARIANT-PRE-COMPILE, module-description=Dio_Impl
    CommonPublishedInformation:
      ArReleaseMajorVersion = 4
      ArReleaseMinorVersion = 2
      ArReleaseRevisionVersion = 2
      ModuleId = 120
      SwMajorVersion = 1
      SwMinorVersion = 0
      SwPatchVersion = 1
      VendorId = 43
    DioConfig
      DioPort_0 (DioPort): DioPortId=3
        DioChannel_PTD16 (DioChannel): DioChannelId=16
        DioChannel_PTD0 (DioChannel): DioChannelId=0
      DioPort_C (DioPort): DioPortId=2
        DioChannel_PTC12 (DioChannel): DioChannelId=12
    DioGeneral:
      DioDevErrorDetect = false
      DioEnableUserModeSupport = false
      DioFlipChannelApi = true
      DioMaskedWritePortApi = false
      DioReadZeroForUndefinedPortPins = false
      DioReversePortBits = false
      DioVersionInfoApi = false
