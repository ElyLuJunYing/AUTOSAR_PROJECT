AUTOSAR XML (schema 00044)
package /VehicleProject
  system System
    root-software-compositions:
      root sw composition prototype EcuSwComposition: software-composition=ECU_Composition
package /ECUCompositionTypes
  composition sw component type ECU_Composition
    4 x component:
      CpLedTask: type=CtLedTask
      Cdd_SBC_UJA1169: type=CddSbc
      Test_SWC_Comp: type=Test_SWC
      Test_SWC2_Comp: type=Test_SWC2
    connect Test_SWC_Comp.Test_SWC_Write -> Test_SWC2_Comp.Test_SWC2_Read
    connect Test_SWC2_Comp.Test_SWC2_Write -> Test_SWC_Comp.Test_SWC_Read
    connect Test_SWC_Comp.Test_SWC_Service -> Test_SWC2_Comp.Test_SWC2_Client
package /EndToEndProtections
  end to end protection set EndToEndProtectionSet
