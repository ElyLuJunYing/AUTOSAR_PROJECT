AUTOSAR XML (schema 00044)
package /COM/VECTOR/CFG/WORKFLOW/SYSDESC/SYNC
  system SYSTEM: category=ECU_EXTRACT
    system mapping MAPPINGS
      data-mappings:
        data-element=CpLedTask.COMPOSITIONTYPE.LampCnt.u8_Signal, system-signal=sig_LampCnt
        data-element=CpLedTask.COMPOSITIONTYPE.RearInteriorLight.Bool_Siganl, system-signal=sig_RearInteriorLight
        data-element=CpLedTask.COMPOSITIONTYPE.FrontInterLight.bool_Signal, system-signal=sig_FrontInterLight
        data-element=CpLedTask.COMPOSITIONTYPE.RearLeftWindowPosition.u8_Signal, system-signal=sig_RearLeftWindowPosition
        data-element=CpLedTask.COMPOSITIONTYPE.RearRightWindowPosition.u8_Signal, system-signal=sig_RearRightWindowPosition
    root-software-compositions:
      root sw composition prototype COMPOSITIONTYPE: flat-map=FLATMAP, software-composition=COMPOSITIONTYPE
  composition sw component type COMPOSITIONTYPE  # UB:Derived from original system description
    12 x component:
      BswM: type=BswM
      ComM: type=ComM
      Det: type=Det
      EcuM: type=EcuM
      Os_OsCore0_swc: type=Os_OsCore0_swc
      DemMaster_0: type=DemMaster_0
      DemSatellite_0: type=DemSatellite_0
      Dcm: type=Dcm
      CpLedTask: type=CtLedTask
      Cdd_SBC_UJA1169: type=CddSbc
      Test_SWC_Comp: type=Test_SWC
      Test_SWC2_Comp: type=Test_SWC2
    connect BswM.Switch_ESH_ModeSwitch -> BswM.Notification_ESH_ModeNotification
    connect ComM.UR_CN_CAN00_06ecbb07 -> CpLedTask.UR_CN_CAN00_06ecbb07
    connect Test_SWC_Comp.Test_SWC_Write -> Test_SWC2_Comp.Test_SWC2_Read  # UB:Derived from original system description
    connect Test_SWC2_Comp.Test_SWC2_Write -> Test_SWC_Comp.Test_SWC_Read  # UB:Derived from original system description
    connect Test_SWC_Comp.Test_SWC_Service -> Test_SWC2_Comp.Test_SWC2_Client  # UB:Derived from original system description
  end to end protection set E2EPROTECTIONSET
  port interface mapping set PORTINTERFACEMAPPINGSET
